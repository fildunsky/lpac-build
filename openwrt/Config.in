## openwrt/Config.in
```kconfig
menu "Configuration"
	depends on PACKAGE_lpac

config LPAC_WITH_PCSC
	bool "Include APDU PCSC Backend support"
	default n
	help
	  Compile LPAC with APDU PCSC Backend support (local smartcard readers).
	  Adds libpcsclite + pcscd dependencies; not needed for USB modems.

config LPAC_WITH_AT
	bool "Include APDU AT Backend support"
	default y
	help
	  Native AT APDU backend (Fibocom FM350-GL and other modems that expose
	  AT+CCHO/CGLA on a serial port).

config LPAC_WITH_QMI
	bool "Include APDU QMI (libqmi) Backend support"
	default y
	help
	  QMI APDU backend via libqmi (talks to the eUICC over cdc-wdm through
	  qmi-proxy, so it shares the channel with the data session). For Qualcomm
	  modems such as Foxconn T99W175 / Thales MV31-W / Dell DW5930e. Adds a
	  libqmi dependency.

config LPAC_WITH_UQMI
	bool "Include APDU uqmi Backend support"
	default y
	help
	  QMI APDU backend via the uqmi CLI (fallback where the libqmi backend does
	  not work). Adds a uqmi dependency.

config LPAC_WITH_MBIM
	bool "Include APDU MBIM Backend support"
	default y
	help
	  MBIM APDU backend via libmbim (talks to the eUICC over cdc-wdm through
	  mbim-proxy). For modems running an MBIM composition. Adds a libmbim
	  dependency.

endmenu
```
